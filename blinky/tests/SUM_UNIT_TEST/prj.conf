## Kconfig
```
mainmenu "Sum unit tests"

source "Kconfig.zephyr"
```

## prj.conf
```kconfig
CONFIG_ZTEST=y
CONFIG_ZTEST_ASSERT_VERBOSE=2
CONFIG_LOG=y
CONFIG_LOG_DEFAULT_LEVEL=3
# Emit logs before the simulator exits at the end of the test suite.
CONFIG_LOG_MODE_IMMEDIATE=y
```

## boards/nrf7002dk_nrf5340_cpuapp_ns.overlay
```dts
/* Reuse the application's direct TF-M boot layout for optional board tests. */
#include "../../../boards/nrf7002dk_nrf5340_cpuapp_ns.overlay"
```

## src/sum_test.c
```c
#include <zephyr/ztest.h>
#include "sum_log.h"

ZTEST(sum_log_test_suite, test_sum_log_basic)
{
	zassert_equal(sum_log(3, 5), 8, "3 + 5 should equal 8");
	zassert_equal(sum_log(5, 3), 8, "5 + 3 should equal 8");
}

ZTEST(sum_log_test_suite, test_sum_log_negative)
{
	zassert_equal(sum_log(-3, -5), -8, "Two negative inputs");
	zassert_equal(sum_log(-3, 5), 2, "Mixed signs with positive result");
	zassert_equal(sum_log(3, -5), -2, "Mixed signs with negative result");
}

ZTEST(sum_log_test_suite, test_sum_log_zero)
{
	zassert_equal(sum_log(0, 0), 0, "Both inputs zero");
	zassert_equal(sum_log(0, 5), 5, "Left input zero");
	zassert_equal(sum_log(-5, 0), -5, "Right input zero");
	zassert_equal(sum_log(5, -5), 0, "Opposite inputs cancel");
}

ZTEST_SUITE(sum_log_test_suite, NULL, NULL, NULL, NULL, NULL);
```
