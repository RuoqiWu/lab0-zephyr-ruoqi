## CMakeLists.txt
```
cmake_minimum_required(VERSION 3.20.0)
find_package(Zephyr REQUIRED HINTS $ENV{ZEPHYR_BASE})
project(lab_stages)
target_sources(app PRIVATE src/main.c)
```

## Kconfig
```
mainmenu "Lab 0 Parts 2 to 5"

config LAB_BUTTON_DEMO
	bool "Part 5: toggle LED2 on a button press"
	default n

config LAB_BLINK_INTERVAL_MS
	int "Delay between LED toggles in milliseconds"
	range 1 60000
	default 2000

source "Kconfig.zephyr"
```

## prj.conf
```kconfig
CONFIG_GPIO=y
CONFIG_CONSOLE=y
CONFIG_SERIAL=y
CONFIG_UART_CONSOLE=y
CONFIG_PRINTK=y
CONFIG_LAB_BLINK_INTERVAL_MS=2000
```

## original.conf
```kconfig
# Optional original-rate demonstration for the Part 2 video.
CONFIG_LAB_BLINK_INTERVAL_MS=1000
```

## part5.conf
```kconfig
CONFIG_LAB_BUTTON_DEMO=y
```

## boards/nrf7002dk_nrf5340_cpuapp_ns.overlay
```dts
/* Share the already verified direct-boot layout and application aliases. */
#include "../../boards/nrf7002dk_nrf5340_cpuapp_ns.overlay"
```

## src/main.c
```c
#include <zephyr/kernel.h>
#include <zephyr/drivers/gpio.h>
#include <zephyr/sys/printk.h>

#if defined(CONFIG_LAB_BUTTON_DEMO)
#define DEMO_LED_NODE DT_ALIAS(led5180)
static const struct gpio_dt_spec button =
	GPIO_DT_SPEC_GET(DT_ALIAS(button5180), gpios);
#else
/* Part 2 keeps the original Blinky LED; Part 5 switches to LED2. */
#define DEMO_LED_NODE DT_ALIAS(led0)
#endif

static const struct gpio_dt_spec led =
	GPIO_DT_SPEC_GET(DEMO_LED_NODE, gpios);

int main(void)
{
	if (!gpio_is_ready_dt(&led)) {
		printk("LED GPIO is not ready\n");
		return 0;
	}
	int ret = gpio_pin_configure_dt(&led, GPIO_OUTPUT_INACTIVE);
	if (ret < 0) {
		printk("LED configuration failed: %d\n", ret);
		return 0;
	}
	bool on = false;

#if defined(CONFIG_LAB_BUTTON_DEMO)
	if (!gpio_is_ready_dt(&button)) {
		printk("Button GPIO is not ready\n");
		return 0;
	}
	ret = gpio_pin_configure_dt(&button, GPIO_INPUT);
	if (ret < 0) {
		printk("Button configuration failed: %d\n", ret);
		return 0;
	}
	bool was_pressed = false;
	while (1) {
		int pressed = gpio_pin_get_dt(&button);
		if (pressed < 0) {
			printk("Button read failed: %d\n", pressed);
			return 0;
		}
		if (pressed && !was_pressed) {
			ret = gpio_pin_toggle_dt(&led);
			if (ret < 0) {
				printk("LED toggle failed: %d\n", ret);
				return 0;
			}
			on = !on;
			printk("Part 5 LED2: %s\n", on ? "ON" : "OFF");
		}
		was_pressed = pressed;
		k_msleep(20);
	}
#else
	while (1) {
		ret = gpio_pin_toggle_dt(&led);
		if (ret < 0) {
			printk("LED toggle failed: %d\n", ret);
			return 0;
		}
		on = !on;
		printk("Blinky LED: %s; toggle interval: %d ms\n",
		       on ? "ON" : "OFF", CONFIG_LAB_BLINK_INTERVAL_MS);
		k_msleep(CONFIG_LAB_BLINK_INTERVAL_MS);
	}
#endif
}
```
